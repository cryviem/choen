# ior7f701503 register map
Registers are 8-bit, access not given, no defined reset value unless marked. A register's access mark holds for its fields unless they carry their own. Addresses are absolute; registers are grouped by the start of their names; [hi:lo] are bit positions; {n}, {i} and the like mark numbered series.

## SFR (part 2 of 4)
{0xFFD00504+0x10*i} RSCAN0GAFLM{i}LL (i=0..15)
{0xFFD00505+0x10*i} RSCAN0GAFLM{i}LH (i=0..15)
{0xFFD00506+0x10*i} RSCAN0GAFLM{i}H 16-bit (i=0..15)
{0xFFD00506+0x10*i} RSCAN0GAFLM{i}HL (i=0..15)
{0xFFD00507+0x10*i} RSCAN0GAFLM{i}HH (i=0..15)
{0xFFD00508+0x10*i} RSCAN0GAFLP{i:02} 32-bit (i=0..9)
{0xFFD00508+0x10*i} RSCAN0GAFLP{i:02}L 16-bit (i=0..9)
{0xFFD00509+0x10*i} RSCAN0GAFLP{i:02}LH (i=0..9)
{0xFFD0050A+0x10*i} RSCAN0GAFLP{i:02}H 16-bit (i=0..9)
{0xFFD0050A+0x10*i} RSCAN0GAFLP{i:02}HL (i=0..9)
{0xFFD0050B+0x10*i} RSCAN0GAFLP{i:02}HH (i=0..9)
0xFFD0050C RSCAN0GAFLP10 32-bit
0xFFD0050C RSCAN0GAFLP10L 16-bit
{0xFFD0046C+0x10*i} RSCAN0GAFLP{i}LL (i=10..19)
0xFFD0050D RSCAN0GAFLP10LH
0xFFD0050E RSCAN0GAFLP10H 16-bit
0xFFD0050E RSCAN0GAFLP10HL
0xFFD0050F RSCAN0GAFLP10HH
0xFFD0051C RSCAN0GAFLP11 32-bit
0xFFD0051C RSCAN0GAFLP11L 16-bit
0xFFD0051D RSCAN0GAFLP11LH
0xFFD0051E RSCAN0GAFLP11H 16-bit
0xFFD0051E RSCAN0GAFLP11HL
0xFFD0051F RSCAN0GAFLP11HH
0xFFD0052C RSCAN0GAFLP12 32-bit
0xFFD0052C RSCAN0GAFLP12L 16-bit
0xFFD0052D RSCAN0GAFLP12LH
0xFFD0052E RSCAN0GAFLP12H 16-bit
0xFFD0052E RSCAN0GAFLP12HL
0xFFD0052F RSCAN0GAFLP12HH
0xFFD0053C RSCAN0GAFLP13 32-bit
0xFFD0053C RSCAN0GAFLP13L 16-bit
0xFFD0053D RSCAN0GAFLP13LH
0xFFD0053E RSCAN0GAFLP13H 16-bit
0xFFD0053E RSCAN0GAFLP13HL
0xFFD0053F RSCAN0GAFLP13HH
0xFFD0054C RSCAN0GAFLP14 32-bit
0xFFD0054C RSCAN0GAFLP14L 16-bit
0xFFD0054D RSCAN0GAFLP14LH
0xFFD0054E RSCAN0GAFLP14H 16-bit
0xFFD0054E RSCAN0GAFLP14HL
0xFFD0054F RSCAN0GAFLP14HH
0xFFD0055C RSCAN0GAFLP15 32-bit
0xFFD0055C RSCAN0GAFLP15L 16-bit
0xFFD0055D RSCAN0GAFLP15LH
0xFFD0055E RSCAN0GAFLP15H 16-bit
0xFFD0055E RSCAN0GAFLP15HL
0xFFD0055F RSCAN0GAFLP15HH
{0xFFD0046C+0x10*i} RSCAN0GAFLP{i} 32-bit (i=16..19)
{0xFFD0046C+0x10*i} RSCAN0GAFLP{i}L 16-bit (i=16..19)
{0xFFD0046D+0x10*i} RSCAN0GAFLP{i}LH (i=16..19)
{0xFFD0046E+0x10*i} RSCAN0GAFLP{i}H 16-bit (i=16..19)
{0xFFD0046E+0x10*i} RSCAN0GAFLP{i}HL (i=16..19)
{0xFFD0046F+0x10*i} RSCAN0GAFLP{i}HH (i=16..19)
0xFFD005A8 RSCAN0GAFLP010 32-bit
0xFFD005A8 RSCAN0GAFLP010L 16-bit
0xFFD005A9 RSCAN0GAFLP010LH
0xFFD005AA RSCAN0GAFLP010H 16-bit
0xFFD005AA RSCAN0GAFLP010HL
0xFFD005AB RSCAN0GAFLP010HH
{0xFFCFFECC+0x10*i} RSCAN0GAFLP{i} 32-bit (i=110..115)
{0xFFCFFECC+0x10*i} RSCAN0GAFLP{i}L 16-bit (i=110..115)
{0xFFCFFECC+0x10*i} RSCAN0GAFLP{i}LL (i=110..115)
{0xFFCFFECD+0x10*i} RSCAN0GAFLP{i}LH (i=110..115)
{0xFFCFFECE+0x10*i} RSCAN0GAFLP{i}H 16-bit (i=110..115)
{0xFFCFFECE+0x10*i} RSCAN0GAFLP{i}HL (i=110..115)
{0xFFCFFECF+0x10*i} RSCAN0GAFLP{i}HH (i=110..115)
0xFFD005B8 RSCAN0GAFLP011 32-bit
0xFFD005B8 RSCAN0GAFLP011L 16-bit
0xFFD005B9 RSCAN0GAFLP011LH
0xFFD005BA RSCAN0GAFLP011H 16-bit
0xFFD005BA RSCAN0GAFLP011HL
0xFFD005BB RSCAN0GAFLP011HH
0xFFD005C8 RSCAN0GAFLP012 32-bit
0xFFD005C8 RSCAN0GAFLP012L 16-bit
0xFFD005C9 RSCAN0GAFLP012LH
0xFFD005CA RSCAN0GAFLP012H 16-bit
0xFFD005CA RSCAN0GAFLP012HL
0xFFD005CB RSCAN0GAFLP012HH
0xFFD005D8 RSCAN0GAFLP013 32-bit
0xFFD005D8 RSCAN0GAFLP013L 16-bit
0xFFD005D9 RSCAN0GAFLP013LH
0xFFD005DA RSCAN0GAFLP013H 16-bit
0xFFD005DA RSCAN0GAFLP013HL
0xFFD005DB RSCAN0GAFLP013HH
0xFFD005E8 RSCAN0GAFLP014 32-bit
0xFFD005E8 RSCAN0GAFLP014L 16-bit
0xFFD005E9 RSCAN0GAFLP014LH
0xFFD005EA RSCAN0GAFLP014H 16-bit
0xFFD005EA RSCAN0GAFLP014HL
0xFFD005EB RSCAN0GAFLP014HH
0xFFD005F8 RSCAN0GAFLP015 32-bit
0xFFD005F8 RSCAN0GAFLP015L 16-bit
0xFFD005F9 RSCAN0GAFLP015LH
0xFFD005FA RSCAN0GAFLP015H 16-bit
0xFFD005FA RSCAN0GAFLP015HL
0xFFD005FB RSCAN0GAFLP015HH
{0xFFD00600+0x10*i} RSCAN0RMID{i} 32-bit ro (i=0..95)
{0xFFD00600+0x10*i} RSCAN0RMID{i}L 16-bit ro (i=0..95)
{0xFFD00600+0x10*i} RSCAN0RMID{i}LL ro (i=0..95)
{0xFFD00601+0x10*i} RSCAN0RMID{i}LH ro (i=0..95)
{0xFFD00602+0x10*i} RSCAN0RMID{i}H 16-bit ro (i=0..95)
{0xFFD00602+0x10*i} RSCAN0RMID{i}HL ro (i=0..95)
{0xFFD00603+0x10*i} RSCAN0RMID{i}HH ro (i=0..95)
{0xFFD00604+0x10*i} RSCAN0RMPTR{i} 32-bit ro (i=0..95)
{0xFFD00604+0x10*i} RSCAN0RMPTR{i}L 16-bit ro (i=0..95)
{0xFFD00604+0x10*i} RSCAN0RMPTR{i}LL ro (i=0..95)
{0xFFD00605+0x10*i} RSCAN0RMPTR{i}LH ro (i=0..95)
{0xFFD00606+0x10*i} RSCAN0RMPTR{i}H 16-bit ro (i=0..95)
{0xFFD00606+0x10*i} RSCAN0RMPTR{i}HL ro (i=0..95)
{0xFFD00607+0x10*i} RSCAN0RMPTR{i}HH ro (i=0..95)
{0xFFD00608+0x10*i} RSCAN0RMDF{i:02} 32-bit ro (i=0..9)
{0xFFD00608+0x10*i} RSCAN0RMDF{i:02}L 16-bit ro (i=0..9)
{0xFFD00608+0x10*i} RSCAN0RMDF{i:02}LL ro (i=0..9)
{0xFFD00609+0x10*i} RSCAN0RMDF{i:02}LH ro (i=0..9)
{0xFFD0060A+0x10*i} RSCAN0RMDF{i:02}H 16-bit ro (i=0..9)
{0xFFD0060A+0x10*i} RSCAN0RMDF{i:02}HL ro (i=0..9)
{0xFFD0060B+0x10*i} RSCAN0RMDF{i:02}HH ro (i=0..9)
0xFFD0060C RSCAN0RMDF10 32-bit ro
0xFFD0060C RSCAN0RMDF10L 16-bit ro
0xFFD0060C RSCAN0RMDF10LL ro
0xFFD0060D RSCAN0RMDF10LH ro
0xFFD0060E RSCAN0RMDF10H 16-bit ro
0xFFD0060E RSCAN0RMDF10HL ro
0xFFD0060F RSCAN0RMDF10HH ro
0xFFD0061C RSCAN0RMDF11 32-bit ro
0xFFD0061C RSCAN0RMDF11L 16-bit ro
0xFFD0061C RSCAN0RMDF11LL ro
0xFFD0061D RSCAN0RMDF11LH ro
0xFFD0061E RSCAN0RMDF11H 16-bit ro
0xFFD0061E RSCAN0RMDF11HL ro
0xFFD0061F RSCAN0RMDF11HH ro
0xFFD0062C RSCAN0RMDF12 32-bit ro
0xFFD0062C RSCAN0RMDF12L 16-bit ro
0xFFD0062C RSCAN0RMDF12LL ro
0xFFD0062D RSCAN0RMDF12LH ro
0xFFD0062E RSCAN0RMDF12H 16-bit ro
0xFFD0062E RSCAN0RMDF12HL ro
0xFFD0062F RSCAN0RMDF12HH ro
0xFFD0063C RSCAN0RMDF13 32-bit ro
0xFFD0063C RSCAN0RMDF13L 16-bit ro
0xFFD0063C RSCAN0RMDF13LL ro
0xFFD0063D RSCAN0RMDF13LH ro
0xFFD0063E RSCAN0RMDF13H 16-bit ro
0xFFD0063E RSCAN0RMDF13HL ro
0xFFD0063F RSCAN0RMDF13HH ro
0xFFD0064C RSCAN0RMDF14 32-bit ro
0xFFD0064C RSCAN0RMDF14L 16-bit ro
0xFFD0064C RSCAN0RMDF14LL ro
0xFFD0064D RSCAN0RMDF14LH ro
0xFFD0064E RSCAN0RMDF14H 16-bit ro
0xFFD0064E RSCAN0RMDF14HL ro
0xFFD0064F RSCAN0RMDF14HH ro
0xFFD0065C RSCAN0RMDF15 32-bit ro
0xFFD0065C RSCAN0RMDF15L 16-bit ro
0xFFD0065C RSCAN0RMDF15LL ro
0xFFD0065D RSCAN0RMDF15LH ro
0xFFD0065E RSCAN0RMDF15H 16-bit ro
0xFFD0065E RSCAN0RMDF15HL ro
0xFFD0065F RSCAN0RMDF15HH ro
0xFFD0066C RSCAN0RMDF16 32-bit ro
0xFFD0066C RSCAN0RMDF16L 16-bit ro
0xFFD0066C RSCAN0RMDF16LL ro
0xFFD0066D RSCAN0RMDF16LH ro
0xFFD0066E RSCAN0RMDF16H 16-bit ro
0xFFD0066E RSCAN0RMDF16HL ro
0xFFD0066F RSCAN0RMDF16HH ro
0xFFD0067C RSCAN0RMDF17 32-bit ro
0xFFD0067C RSCAN0RMDF17L 16-bit ro
0xFFD0067C RSCAN0RMDF17LL ro
0xFFD0067D RSCAN0RMDF17LH ro
0xFFD0067E RSCAN0RMDF17H 16-bit ro
0xFFD0067E RSCAN0RMDF17HL ro
0xFFD0067F RSCAN0RMDF17HH ro
0xFFD0068C RSCAN0RMDF18 32-bit ro
0xFFD0068C RSCAN0RMDF18L 16-bit ro
0xFFD0068C RSCAN0RMDF18LL ro
0xFFD0068D RSCAN0RMDF18LH ro
0xFFD0068E RSCAN0RMDF18H 16-bit ro
0xFFD0068E RSCAN0RMDF18HL ro
0xFFD0068F RSCAN0RMDF18HH ro
0xFFD0069C RSCAN0RMDF19 32-bit ro
0xFFD0069C RSCAN0RMDF19L 16-bit ro
0xFFD0069C RSCAN0RMDF19LL ro
0xFFD0069D RSCAN0RMDF19LH ro
0xFFD0069E RSCAN0RMDF19H 16-bit ro
0xFFD0069E RSCAN0RMDF19HL ro
0xFFD0069F RSCAN0RMDF19HH ro
0xFFD006A8 RSCAN0RMDF010 32-bit ro
0xFFD006A8 RSCAN0RMDF010L 16-bit ro
0xFFD006A8 RSCAN0RMDF010LL ro
0xFFD006A9 RSCAN0RMDF010LH ro
0xFFD006AA RSCAN0RMDF010H 16-bit ro
0xFFD006AA RSCAN0RMDF010HL ro
0xFFD006AB RSCAN0RMDF010HH ro
{0xFFCFFFCC+0x10*i} RSCAN0RMDF{i} 32-bit ro (i=110..195)
{0xFFCFFFCC+0x10*i} RSCAN0RMDF{i}L 16-bit ro (i=110..195)
{0xFFCFFFCC+0x10*i} RSCAN0RMDF{i}LL ro (i=110..195)
{0xFFCFFFCD+0x10*i} RSCAN0RMDF{i}LH ro (i=110..195)
{0xFFCFFFCE+0x10*i} RSCAN0RMDF{i}H 16-bit ro (i=110..195)
{0xFFCFFFCE+0x10*i} RSCAN0RMDF{i}HL ro (i=110..195)
{0xFFCFFFCF+0x10*i} RSCAN0RMDF{i}HH ro (i=110..195)
0xFFD006B8 RSCAN0RMDF011 32-bit ro
0xFFD006B8 RSCAN0RMDF011L 16-bit ro
0xFFD006B8 RSCAN0RMDF011LL ro
0xFFD006B9 RSCAN0RMDF011LH ro
0xFFD006BA RSCAN0RMDF011H 16-bit ro
0xFFD006BA RSCAN0RMDF011HL ro
0xFFD006BB RSCAN0RMDF011HH ro
0xFFD006C8 RSCAN0RMDF012 32-bit ro
0xFFD006C8 RSCAN0RMDF012L 16-bit ro
0xFFD006C8 RSCAN0RMDF012LL ro
0xFFD006C9 RSCAN0RMDF012LH ro
0xFFD006CA RSCAN0RMDF012H 16-bit ro
0xFFD006CA RSCAN0RMDF012HL ro
0xFFD006CB RSCAN0RMDF012HH ro
0xFFD006D8 RSCAN0RMDF013 32-bit ro
0xFFD006D8 RSCAN0RMDF013L 16-bit ro
0xFFD006D8 RSCAN0RMDF013LL ro
0xFFD006D9 RSCAN0RMDF013LH ro
0xFFD006DA RSCAN0RMDF013H 16-bit ro
0xFFD006DA RSCAN0RMDF013HL ro
0xFFD006DB RSCAN0RMDF013HH ro
0xFFD006E8 RSCAN0RMDF014 32-bit ro
0xFFD006E8 RSCAN0RMDF014L 16-bit ro
0xFFD006E8 RSCAN0RMDF014LL ro
0xFFD006E9 RSCAN0RMDF014LH ro
0xFFD006EA RSCAN0RMDF014H 16-bit ro
0xFFD006EA RSCAN0RMDF014HL ro
0xFFD006EB RSCAN0RMDF014HH ro
0xFFD006F8 RSCAN0RMDF015 32-bit ro
0xFFD006F8 RSCAN0RMDF015L 16-bit ro
0xFFD006F8 RSCAN0RMDF015LL ro
0xFFD006F9 RSCAN0RMDF015LH ro
0xFFD006FA RSCAN0RMDF015H 16-bit ro
0xFFD006FA RSCAN0RMDF015HL ro
0xFFD006FB RSCAN0RMDF015HH ro
0xFFD00708 RSCAN0RMDF016 32-bit ro
0xFFD00708 RSCAN0RMDF016L 16-bit ro
0xFFD00708 RSCAN0RMDF016LL ro
0xFFD00709 RSCAN0RMDF016LH ro
0xFFD0070A RSCAN0RMDF016H 16-bit ro
0xFFD0070A RSCAN0RMDF016HL ro
0xFFD0070B RSCAN0RMDF016HH ro
0xFFD00718 RSCAN0RMDF017 32-bit ro
0xFFD00718 RSCAN0RMDF017L 16-bit ro
0xFFD00718 RSCAN0RMDF017LL ro
0xFFD00719 RSCAN0RMDF017LH ro
0xFFD0071A RSCAN0RMDF017H 16-bit ro
0xFFD0071A RSCAN0RMDF017HL ro
0xFFD0071B RSCAN0RMDF017HH ro
0xFFD00728 RSCAN0RMDF018 32-bit ro
0xFFD00728 RSCAN0RMDF018L 16-bit ro
0xFFD00728 RSCAN0RMDF018LL ro
0xFFD00729 RSCAN0RMDF018LH ro
0xFFD0072A RSCAN0RMDF018H 16-bit ro
0xFFD0072A RSCAN0RMDF018HL ro
0xFFD0072B RSCAN0RMDF018HH ro
{0xFFD00608+0x10*i} RSCAN0RMDF{i:03} 32-bit ro (i=19..95)
{0xFFD00608+0x10*i} RSCAN0RMDF{i:03}L 16-bit ro (i=19..95)
{0xFFD00608+0x10*i} RSCAN0RMDF{i:03}LL ro (i=19..95)
{0xFFD00609+0x10*i} RSCAN0RMDF{i:03}LH ro (i=19..95)
{0xFFD0060A+0x10*i} RSCAN0RMDF{i:03}H 16-bit ro (i=19..95)
{0xFFD0060A+0x10*i} RSCAN0RMDF{i:03}HL ro (i=19..95)
{0xFFD0060B+0x10*i} RSCAN0RMDF{i:03}HH ro (i=19..95)
{0xFFD00E00+0x10*i} RSCAN0RFID{i} 32-bit ro (i=0..7)
{0xFFD00E00+0x10*i} RSCAN0RFID{i}L 16-bit ro (i=0..7)
{0xFFD00E00+0x10*i} RSCAN0RFID{i}LL ro (i=0..7)
{0xFFD00E01+0x10*i} RSCAN0RFID{i}LH ro (i=0..7)
{0xFFD00E02+0x10*i} RSCAN0RFID{i}H 16-bit ro (i=0..7)
{0xFFD00E02+0x10*i} RSCAN0RFID{i}HL ro (i=0..7)
{0xFFD00E03+0x10*i} RSCAN0RFID{i}HH ro (i=0..7)
{0xFFD00E04+0x10*i} RSCAN0RFPTR{i} 32-bit ro (i=0..7)
{0xFFD00E04+0x10*i} RSCAN0RFPTR{i}L 16-bit ro (i=0..7)
{0xFFD00E04+0x10*i} RSCAN0RFPTR{i}LL ro (i=0..7)
{0xFFD00E05+0x10*i} RSCAN0RFPTR{i}LH ro (i=0..7)
{0xFFD00E06+0x10*i} RSCAN0RFPTR{i}H 16-bit ro (i=0..7)
{0xFFD00E06+0x10*i} RSCAN0RFPTR{i}HL ro (i=0..7)
{0xFFD00E07+0x10*i} RSCAN0RFPTR{i}HH ro (i=0..7)
{0xFFD00E08+0x10*i} RSCAN0RFDF{i:02} 32-bit ro (i=0..7)
{0xFFD00E08+0x10*i} RSCAN0RFDF{i:02}L 16-bit ro (i=0..7)
{0xFFD00E08+0x10*i} RSCAN0RFDF{i:02}LL ro (i=0..7)
{0xFFD00E09+0x10*i} RSCAN0RFDF{i:02}LH ro (i=0..7)
{0xFFD00E0A+0x10*i} RSCAN0RFDF{i:02}H 16-bit ro (i=0..7)
{0xFFD00E0A+0x10*i} RSCAN0RFDF{i:02}HL ro (i=0..7)
{0xFFD00E0B+0x10*i} RSCAN0RFDF{i:02}HH ro (i=0..7)
{0xFFD00D6C+0x10*i} RSCAN0RFDF{i} 32-bit ro (i=10..17)
{0xFFD00D6C+0x10*i} RSCAN0RFDF{i}L 16-bit ro (i=10..17)
{0xFFD00D6C+0x10*i} RSCAN0RFDF{i}LL ro (i=10..17)
{0xFFD00D6D+0x10*i} RSCAN0RFDF{i}LH ro (i=10..17)
{0xFFD00D6E+0x10*i} RSCAN0RFDF{i}H 16-bit ro (i=10..17)
{0xFFD00D6E+0x10*i} RSCAN0RFDF{i}HL ro (i=10..17)
{0xFFD00D6F+0x10*i} RSCAN0RFDF{i}HH ro (i=10..17)
{0xFFD00E80+0x10*i} RSCAN0CFID{i} 32-bit (i=0..17)
{0xFFD00E80+0x10*i} RSCAN0CFID{i}L 16-bit (i=0..17)
{0xFFD00E80+0x10*i} RSCAN0CFID{i}LL (i=0..17)
{0xFFD00E81+0x10*i} RSCAN0CFID{i}LH (i=0..17)
{0xFFD00E82+0x10*i} RSCAN0CFID{i}H 16-bit (i=0..17)
{0xFFD00E82+0x10*i} RSCAN0CFID{i}HL (i=0..17)
{0xFFD00E83+0x10*i} RSCAN0CFID{i}HH (i=0..17)
{0xFFD00E84+0x10*i} RSCAN0CFPTR{i} 32-bit (i=0..17)
{0xFFD00E84+0x10*i} RSCAN0CFPTR{i}L 16-bit (i=0..17)
{0xFFD00E84+0x10*i} RSCAN0CFPTR{i}LL (i=0..17)
{0xFFD00E85+0x10*i} RSCAN0CFPTR{i}LH (i=0..17)
{0xFFD00E86+0x10*i} RSCAN0CFPTR{i}H 16-bit (i=0..17)
{0xFFD00E86+0x10*i} RSCAN0CFPTR{i}HL (i=0..17)
{0xFFD00E87+0x10*i} RSCAN0CFPTR{i}HH (i=0..17)
{0xFFD00E88+0x10*i} RSCAN0CFDF{i:02} 32-bit (i=0..9)
{0xFFD00E88+0x10*i} RSCAN0CFDF{i:02}L 16-bit (i=0..9)
{0xFFD00E88+0x10*i} RSCAN0CFDF{i:02}LL (i=0..9)
{0xFFD00E89+0x10*i} RSCAN0CFDF{i:02}LH (i=0..9)
{0xFFD00E8A+0x10*i} RSCAN0CFDF{i:02}H 16-bit (i=0..9)
{0xFFD00E8A+0x10*i} RSCAN0CFDF{i:02}HL (i=0..9)
{0xFFD00E8B+0x10*i} RSCAN0CFDF{i:02}HH (i=0..9)
0xFFD00E8C RSCAN0CFDF10 32-bit
0xFFD00E8C RSCAN0CFDF10L 16-bit
0xFFD00E8C RSCAN0CFDF10LL
0xFFD00E8D RSCAN0CFDF10LH
0xFFD00E8E RSCAN0CFDF10H 16-bit
0xFFD00E8E RSCAN0CFDF10HL
0xFFD00E8F RSCAN0CFDF10HH
0xFFD00E9C RSCAN0CFDF11 32-bit
0xFFD00E9C RSCAN0CFDF11L 16-bit
0xFFD00E9C RSCAN0CFDF11LL
0xFFD00E9D RSCAN0CFDF11LH
0xFFD00E9E RSCAN0CFDF11H 16-bit
0xFFD00E9E RSCAN0CFDF11HL
0xFFD00E9F RSCAN0CFDF11HH
0xFFD00EAC RSCAN0CFDF12 32-bit
0xFFD00EAC RSCAN0CFDF12L 16-bit
0xFFD00EAC RSCAN0CFDF12LL
0xFFD00EAD RSCAN0CFDF12LH
0xFFD00EAE RSCAN0CFDF12H 16-bit
0xFFD00EAE RSCAN0CFDF12HL
0xFFD00EAF RSCAN0CFDF12HH
0xFFD00EBC RSCAN0CFDF13 32-bit
0xFFD00EBC RSCAN0CFDF13L 16-bit
0xFFD00EBC RSCAN0CFDF13LL
0xFFD00EBD RSCAN0CFDF13LH
0xFFD00EBE RSCAN0CFDF13H 16-bit
0xFFD00EBE RSCAN0CFDF13HL
0xFFD00EBF RSCAN0CFDF13HH
0xFFD00ECC RSCAN0CFDF14 32-bit
0xFFD00ECC RSCAN0CFDF14L 16-bit
0xFFD00ECC RSCAN0CFDF14LL
0xFFD00ECD RSCAN0CFDF14LH
0xFFD00ECE RSCAN0CFDF14H 16-bit
0xFFD00ECE RSCAN0CFDF14HL
0xFFD00ECF RSCAN0CFDF14HH
0xFFD00EDC RSCAN0CFDF15 32-bit
0xFFD00EDC RSCAN0CFDF15L 16-bit
0xFFD00EDC RSCAN0CFDF15LL
0xFFD00EDD RSCAN0CFDF15LH
0xFFD00EDE RSCAN0CFDF15H 16-bit
0xFFD00EDE RSCAN0CFDF15HL
0xFFD00EDF RSCAN0CFDF15HH
0xFFD00EEC RSCAN0CFDF16 32-bit
0xFFD00EEC RSCAN0CFDF16L 16-bit
0xFFD00EEC RSCAN0CFDF16LL
0xFFD00EED RSCAN0CFDF16LH
0xFFD00EEE RSCAN0CFDF16H 16-bit
0xFFD00EEE RSCAN0CFDF16HL
0xFFD00EEF RSCAN0CFDF16HH
0xFFD00EFC RSCAN0CFDF17 32-bit
0xFFD00EFC RSCAN0CFDF17L 16-bit
0xFFD00EFC RSCAN0CFDF17LL
0xFFD00EFD RSCAN0CFDF17LH
0xFFD00EFE RSCAN0CFDF17H 16-bit
0xFFD00EFE RSCAN0CFDF17HL
0xFFD00EFF RSCAN0CFDF17HH
0xFFD00F0C RSCAN0CFDF18 32-bit
0xFFD00F0C RSCAN0CFDF18L 16-bit
0xFFD00F0C RSCAN0CFDF18LL
0xFFD00F0D RSCAN0CFDF18LH
0xFFD00F0E RSCAN0CFDF18H 16-bit
0xFFD00F0E RSCAN0CFDF18HL
0xFFD00F0F RSCAN0CFDF18HH
0xFFD00F1C RSCAN0CFDF19 32-bit
0xFFD00F1C RSCAN0CFDF19L 16-bit
0xFFD00F1C RSCAN0CFDF19LL
0xFFD00F1D RSCAN0CFDF19LH
0xFFD00F1E RSCAN0CFDF19H 16-bit
0xFFD00F1E RSCAN0CFDF19HL
0xFFD00F1F RSCAN0CFDF19HH
0xFFD00F28 RSCAN0CFDF010 32-bit
0xFFD00F28 RSCAN0CFDF010L 16-bit
0xFFD00F28 RSCAN0CFDF010LL
0xFFD00F29 RSCAN0CFDF010LH
0xFFD00F2A RSCAN0CFDF010H 16-bit
0xFFD00F2A RSCAN0CFDF010HL
0xFFD00F2B RSCAN0CFDF010HH
{0xFFD0084C+0x10*i} RSCAN0CFDF{i} 32-bit (i=110..117)
{0xFFD0084C+0x10*i} RSCAN0CFDF{i}L 16-bit (i=110..117)
{0xFFD0084C+0x10*i} RSCAN0CFDF{i}LL (i=110..117)
{0xFFD0084D+0x10*i} RSCAN0CFDF{i}LH (i=110..117)
{0xFFD0084E+0x10*i} RSCAN0CFDF{i}H 16-bit (i=110..117)
{0xFFD0084E+0x10*i} RSCAN0CFDF{i}HL (i=110..117)
{0xFFD0084F+0x10*i} RSCAN0CFDF{i}HH (i=110..117)
0xFFD00F38 RSCAN0CFDF011 32-bit
0xFFD00F38 RSCAN0CFDF011L 16-bit
0xFFD00F38 RSCAN0CFDF011LL
0xFFD00F39 RSCAN0CFDF011LH
0xFFD00F3A RSCAN0CFDF011H 16-bit
0xFFD00F3A RSCAN0CFDF011HL
0xFFD00F3B RSCAN0CFDF011HH
0xFFD00F48 RSCAN0CFDF012 32-bit
0xFFD00F48 RSCAN0CFDF012L 16-bit
0xFFD00F48 RSCAN0CFDF012LL
0xFFD00F49 RSCAN0CFDF012LH
0xFFD00F4A RSCAN0CFDF012H 16-bit
0xFFD00F4A RSCAN0CFDF012HL
0xFFD00F4B RSCAN0CFDF012HH
0xFFD00F58 RSCAN0CFDF013 32-bit
0xFFD00F58 RSCAN0CFDF013L 16-bit
0xFFD00F58 RSCAN0CFDF013LL
0xFFD00F59 RSCAN0CFDF013LH
0xFFD00F5A RSCAN0CFDF013H 16-bit
0xFFD00F5A RSCAN0CFDF013HL
0xFFD00F5B RSCAN0CFDF013HH
0xFFD00F68 RSCAN0CFDF014 32-bit
0xFFD00F68 RSCAN0CFDF014L 16-bit
0xFFD00F68 RSCAN0CFDF014LL
0xFFD00F69 RSCAN0CFDF014LH
0xFFD00F6A RSCAN0CFDF014H 16-bit
0xFFD00F6A RSCAN0CFDF014HL
0xFFD00F6B RSCAN0CFDF014HH
0xFFD00F78 RSCAN0CFDF015 32-bit
0xFFD00F78 RSCAN0CFDF015L 16-bit
0xFFD00F78 RSCAN0CFDF015LL
0xFFD00F79 RSCAN0CFDF015LH
0xFFD00F7A RSCAN0CFDF015H 16-bit
0xFFD00F7A RSCAN0CFDF015HL
0xFFD00F7B RSCAN0CFDF015HH
0xFFD00F88 RSCAN0CFDF016 32-bit
0xFFD00F88 RSCAN0CFDF016L 16-bit
0xFFD00F88 RSCAN0CFDF016LL
0xFFD00F89 RSCAN0CFDF016LH
0xFFD00F8A RSCAN0CFDF016H 16-bit
0xFFD00F8A RSCAN0CFDF016HL
0xFFD00F8B RSCAN0CFDF016HH
0xFFD00F98 RSCAN0CFDF017 32-bit
0xFFD00F98 RSCAN0CFDF017L 16-bit
0xFFD00F98 RSCAN0CFDF017LL
0xFFD00F99 RSCAN0CFDF017LH
0xFFD00F9A RSCAN0CFDF017H 16-bit
0xFFD00F9A RSCAN0CFDF017HL
0xFFD00F9B RSCAN0CFDF017HH
{0xFFD01000+0x10*i} RSCAN0TMID{i} 32-bit (i=0..95)
{0xFFD01000+0x10*i} RSCAN0TMID{i}L 16-bit (i=0..95)
{0xFFD01000+0x10*i} RSCAN0TMID{i}LL (i=0..95)
{0xFFD01001+0x10*i} RSCAN0TMID{i}LH (i=0..95)
{0xFFD01002+0x10*i} RSCAN0TMID{i}H 16-bit (i=0..95)
{0xFFD01002+0x10*i} RSCAN0TMID{i}HL (i=0..95)
{0xFFD01003+0x10*i} RSCAN0TMID{i}HH (i=0..95)
{0xFFD01004+0x10*i} RSCAN0TMPTR{i} 32-bit (i=0..95)
{0xFFD01006+0x10*i} RSCAN0TMPTR{i}H 16-bit (i=0..95)
{0xFFD01006+0x10*i} RSCAN0TMPTR{i}HL (i=0..95)
{0xFFD01007+0x10*i} RSCAN0TMPTR{i}HH (i=0..95)
{0xFFD01008+0x10*i} RSCAN0TMDF{i:02} 32-bit (i=0..9)
{0xFFD01008+0x10*i} RSCAN0TMDF{i:02}L 16-bit (i=0..9)
{0xFFD01008+0x10*i} RSCAN0TMDF{i:02}LL (i=0..9)
{0xFFD01009+0x10*i} RSCAN0TMDF{i:02}LH (i=0..9)
{0xFFD0100A+0x10*i} RSCAN0TMDF{i:02}H 16-bit (i=0..9)
{0xFFD0100A+0x10*i} RSCAN0TMDF{i:02}HL (i=0..9)
{0xFFD0100B+0x10*i} RSCAN0TMDF{i:02}HH (i=0..9)
0xFFD0100C RSCAN0TMDF10 32-bit
0xFFD0100C RSCAN0TMDF10L 16-bit
0xFFD0100C RSCAN0TMDF10LL
0xFFD0100D RSCAN0TMDF10LH
0xFFD0100E RSCAN0TMDF10H 16-bit
0xFFD0100E RSCAN0TMDF10HL
0xFFD0100F RSCAN0TMDF10HH
0xFFD0101C RSCAN0TMDF11 32-bit
0xFFD0101C RSCAN0TMDF11L 16-bit
0xFFD0101C RSCAN0TMDF11LL
0xFFD0101D RSCAN0TMDF11LH
0xFFD0101E RSCAN0TMDF11H 16-bit
0xFFD0101E RSCAN0TMDF11HL
0xFFD0101F RSCAN0TMDF11HH
0xFFD0102C RSCAN0TMDF12 32-bit
0xFFD0102C RSCAN0TMDF12L 16-bit
0xFFD0102C RSCAN0TMDF12LL
0xFFD0102D RSCAN0TMDF12LH
0xFFD0102E RSCAN0TMDF12H 16-bit
0xFFD0102E RSCAN0TMDF12HL
0xFFD0102F RSCAN0TMDF12HH
0xFFD0103C RSCAN0TMDF13 32-bit
0xFFD0103C RSCAN0TMDF13L 16-bit
0xFFD0103C RSCAN0TMDF13LL
0xFFD0103D RSCAN0TMDF13LH
0xFFD0103E RSCAN0TMDF13H 16-bit
0xFFD0103E RSCAN0TMDF13HL
0xFFD0103F RSCAN0TMDF13HH
0xFFD0104C RSCAN0TMDF14 32-bit
0xFFD0104C RSCAN0TMDF14L 16-bit
0xFFD0104C RSCAN0TMDF14LL
0xFFD0104D RSCAN0TMDF14LH
0xFFD0104E RSCAN0TMDF14H 16-bit
0xFFD0104E RSCAN0TMDF14HL
0xFFD0104F RSCAN0TMDF14HH
0xFFD0105C RSCAN0TMDF15 32-bit
0xFFD0105C RSCAN0TMDF15L 16-bit
0xFFD0105C RSCAN0TMDF15LL
0xFFD0105D RSCAN0TMDF15LH
0xFFD0105E RSCAN0TMDF15H 16-bit
0xFFD0105E RSCAN0TMDF15HL
0xFFD0105F RSCAN0TMDF15HH
0xFFD0106C RSCAN0TMDF16 32-bit
0xFFD0106C RSCAN0TMDF16L 16-bit
0xFFD0106C RSCAN0TMDF16LL
0xFFD0106D RSCAN0TMDF16LH
0xFFD0106E RSCAN0TMDF16H 16-bit
0xFFD0106E RSCAN0TMDF16HL
0xFFD0106F RSCAN0TMDF16HH
0xFFD0107C RSCAN0TMDF17 32-bit
0xFFD0107C RSCAN0TMDF17L 16-bit
0xFFD0107C RSCAN0TMDF17LL
0xFFD0107D RSCAN0TMDF17LH
0xFFD0107E RSCAN0TMDF17H 16-bit
0xFFD0107E RSCAN0TMDF17HL
0xFFD0107F RSCAN0TMDF17HH
0xFFD0108C RSCAN0TMDF18 32-bit
0xFFD0108C RSCAN0TMDF18L 16-bit
0xFFD0108C RSCAN0TMDF18LL
0xFFD0108D RSCAN0TMDF18LH
0xFFD0108E RSCAN0TMDF18H 16-bit
0xFFD0108E RSCAN0TMDF18HL
0xFFD0108F RSCAN0TMDF18HH
0xFFD0109C RSCAN0TMDF19 32-bit
0xFFD0109C RSCAN0TMDF19L 16-bit
0xFFD0109C RSCAN0TMDF19LL
0xFFD0109D RSCAN0TMDF19LH
0xFFD0109E RSCAN0TMDF19H 16-bit
0xFFD0109E RSCAN0TMDF19HL
0xFFD0109F RSCAN0TMDF19HH
0xFFD010A8 RSCAN0TMDF010 32-bit
0xFFD010A8 RSCAN0TMDF010L 16-bit
0xFFD010A8 RSCAN0TMDF010LL
0xFFD010A9 RSCAN0TMDF010LH
0xFFD010AA RSCAN0TMDF010H 16-bit
0xFFD010AA RSCAN0TMDF010HL
0xFFD010AB RSCAN0TMDF010HH
{0xFFD009CC+0x10*i} RSCAN0TMDF{i} 32-bit (i=110..195)
{0xFFD009CC+0x10*i} RSCAN0TMDF{i}L 16-bit (i=110..195)
{0xFFD009CC+0x10*i} RSCAN0TMDF{i}LL (i=110..195)
{0xFFD009CD+0x10*i} RSCAN0TMDF{i}LH (i=110..195)
{0xFFD009CE+0x10*i} RSCAN0TMDF{i}H 16-bit (i=110..195)
{0xFFD009CE+0x10*i} RSCAN0TMDF{i}HL (i=110..195)
{0xFFD009CF+0x10*i} RSCAN0TMDF{i}HH (i=110..195)
0xFFD010B8 RSCAN0TMDF011 32-bit
0xFFD010B8 RSCAN0TMDF011L 16-bit
0xFFD010B8 RSCAN0TMDF011LL
0xFFD010B9 RSCAN0TMDF011LH
0xFFD010BA RSCAN0TMDF011H 16-bit
0xFFD010BA RSCAN0TMDF011HL
0xFFD010BB RSCAN0TMDF011HH
0xFFD010C8 RSCAN0TMDF012 32-bit
0xFFD010C8 RSCAN0TMDF012L 16-bit
0xFFD010C8 RSCAN0TMDF012LL
0xFFD010C9 RSCAN0TMDF012LH
0xFFD010CA RSCAN0TMDF012H 16-bit
0xFFD010CA RSCAN0TMDF012HL
0xFFD010CB RSCAN0TMDF012HH
0xFFD010D8 RSCAN0TMDF013 32-bit
0xFFD010D8 RSCAN0TMDF013L 16-bit
0xFFD010D8 RSCAN0TMDF013LL
0xFFD010D9 RSCAN0TMDF013LH
0xFFD010DA RSCAN0TMDF013H 16-bit
0xFFD010DA RSCAN0TMDF013HL
0xFFD010DB RSCAN0TMDF013HH
0xFFD010E8 RSCAN0TMDF014 32-bit
0xFFD010E8 RSCAN0TMDF014L 16-bit
0xFFD010E8 RSCAN0TMDF014LL
0xFFD010E9 RSCAN0TMDF014LH
0xFFD010EA RSCAN0TMDF014H 16-bit
0xFFD010EA RSCAN0TMDF014HL
0xFFD010EB RSCAN0TMDF014HH
0xFFD010F8 RSCAN0TMDF015 32-bit
0xFFD010F8 RSCAN0TMDF015L 16-bit
0xFFD010F8 RSCAN0TMDF015LL
0xFFD010F9 RSCAN0TMDF015LH
0xFFD010FA RSCAN0TMDF015H 16-bit
0xFFD010FA RSCAN0TMDF015HL
0xFFD010FB RSCAN0TMDF015HH
0xFFD01108 RSCAN0TMDF016 32-bit
0xFFD01108 RSCAN0TMDF016L 16-bit
0xFFD01108 RSCAN0TMDF016LL
0xFFD01109 RSCAN0TMDF016LH
0xFFD0110A RSCAN0TMDF016H 16-bit
0xFFD0110A RSCAN0TMDF016HL
0xFFD0110B RSCAN0TMDF016HH
0xFFD01118 RSCAN0TMDF017 32-bit
0xFFD01118 RSCAN0TMDF017L 16-bit
0xFFD01118 RSCAN0TMDF017LL
0xFFD01119 RSCAN0TMDF017LH
0xFFD0111A RSCAN0TMDF017H 16-bit
0xFFD0111A RSCAN0TMDF017HL
0xFFD0111B RSCAN0TMDF017HH
0xFFD01128 RSCAN0TMDF018 32-bit
0xFFD01128 RSCAN0TMDF018L 16-bit
0xFFD01128 RSCAN0TMDF018LL
0xFFD01129 RSCAN0TMDF018LH
0xFFD0112A RSCAN0TMDF018H 16-bit
0xFFD0112A RSCAN0TMDF018HL
0xFFD0112B RSCAN0TMDF018HH
{0xFFD01008+0x10*i} RSCAN0TMDF{i:03} 32-bit (i=19..95)
{0xFFD01008+0x10*i} RSCAN0TMDF{i:03}L 16-bit (i=19..95)
{0xFFD01008+0x10*i} RSCAN0TMDF{i:03}LL (i=19..95)
{0xFFD01009+0x10*i} RSCAN0TMDF{i:03}LH (i=19..95)
{0xFFD0100A+0x10*i} RSCAN0TMDF{i:03}H 16-bit (i=19..95)
{0xFFD0100A+0x10*i} RSCAN0TMDF{i:03}HL (i=19..95)
{0xFFD0100B+0x10*i} RSCAN0TMDF{i:03}HH (i=19..95)
{0xFFD01800+4i} RSCAN0THLACC{i} 32-bit ro (i=0..5)
{0xFFD01800+4i} RSCAN0THLACC{i}L 16-bit ro (i=0..5)
{0xFFD01800+4i} RSCAN0THLACC{i}LL ro (i=0..5)
{0xFFD01801+4i} RSCAN0THLACC{i}LH ro (i=0..5)
{0xFFD01900+4i} RSCAN0RPGACC{i} 32-bit (i=0..63)
{0xFFD01900+4i} RSCAN0RPGACC{i}L 16-bit (i=0..63)
{0xFFD01900+4i} RSCAN0RPGACC{i}LL (i=0..63)
{0xFFD01901+4i} RSCAN0RPGACC{i}LH (i=0..63)
{0xFFD01902+4i} RSCAN0RPGACC{i}H 16-bit (i=0..63)
{0xFFD01902+4i} RSCAN0RPGACC{i}HL (i=0..63)
{0xFFD01903+4i} RSCAN0RPGACC{i}HH (i=0..63)
0xFFD08000 RSCAN1C6CFG 32-bit
0xFFD08000 RSCAN1C6CFGL 16-bit
0xFFD08000 RSCAN1C6CFGLL
0xFFD08001 RSCAN1C6CFGLH
0xFFD08002 RSCAN1C6CFGH 16-bit
0xFFD08002 RSCAN1C6CFGHL
0xFFD08003 RSCAN1C6CFGHH
0xFFD08004 RSCAN1C6CTR 32-bit
0xFFD08004 RSCAN1C6CTRL 16-bit
0xFFD08004 RSCAN1C6CTRLL
0xFFD08005 RSCAN1C6CTRLH
0xFFD08006 RSCAN1C6CTRH 16-bit
0xFFD08006 RSCAN1C6CTRHL
0xFFD08007 RSCAN1C6CTRHH
0xFFD08008 RSCAN1C6STS 32-bit ro
0xFFD08008 RSCAN1C6STSL 16-bit ro
0xFFD08008 RSCAN1C6STSLL ro
0xFFD0800A RSCAN1C6STSH 16-bit ro
0xFFD0800A RSCAN1C6STSHL ro
0xFFD0800B RSCAN1C6STSHH ro
0xFFD0800C RSCAN1C6ERFL 32-bit
0xFFD0800C RSCAN1C6ERFLL 16-bit
0xFFD0800C RSCAN1C6ERFLLL
0xFFD0800D RSCAN1C6ERFLLH
0xFFD0800E RSCAN1C6ERFLH 16-bit ro
0xFFD0800E RSCAN1C6ERFLHL ro
0xFFD0800F RSCAN1C6ERFLHH ro
0xFFD08084 RSCAN1GCFG 32-bit
0xFFD08084 RSCAN1GCFGL 16-bit
0xFFD08084 RSCAN1GCFGLL
0xFFD08085 RSCAN1GCFGLH
0xFFD08086 RSCAN1GCFGH 16-bit
0xFFD08086 RSCAN1GCFGHL
0xFFD08087 RSCAN1GCFGHH
0xFFD08088 RSCAN1GCTR 32-bit
0xFFD08088 RSCAN1GCTRL 16-bit
0xFFD08088 RSCAN1GCTRLL
0xFFD08089 RSCAN1GCTRLH
0xFFD0808A RSCAN1GCTRH 16-bit
0xFFD0808A RSCAN1GCTRHL
0xFFD0808C RSCAN1GSTS 32-bit ro
0xFFD0808C RSCAN1GSTSL 16-bit ro
0xFFD0808C RSCAN1GSTSLL ro
0xFFD08090 RSCAN1GERFL 32-bit
0xFFD08090 RSCAN1GERFLL 16-bit
0xFFD08090 RSCAN1GERFLLL
0xFFD08094 RSCAN1GTSC 32-bit ro
0xFFD08094 RSCAN1GTSCL 16-bit ro
0xFFD08098 RSCAN1GAFLECTR 32-bit
0xFFD08098 RSCAN1GAFLECTRL 16-bit
0xFFD08098 RSCAN1GAFLECTRLL
0xFFD08099 RSCAN1GAFLECTRLH
0xFFD0809C RSCAN1GAFLCFG0 32-bit
0xFFD0809E RSCAN1GAFLCFG0H 16-bit
0xFFD0809F RSCAN1GAFLCFG0HH
0xFFD080A4 RSCAN1RMNB 32-bit
0xFFD080A4 RSCAN1RMNBL 16-bit
0xFFD080A4 RSCAN1RMNBLL
0xFFD080A8 RSCAN1RMND0 32-bit
0xFFD080A8 RSCAN1RMND0L 16-bit
0xFFD080A8 RSCAN1RMND0LL
0xFFD080A9 RSCAN1RMND0LH
{0xFFD080B8+4i} RSCAN1RFCC{i} 32-bit (i=0..7)
{0xFFD080B8+4i} RSCAN1RFCC{i}L 16-bit (i=0..7)
{0xFFD080B8+4i} RSCAN1RFCC{i}LL (i=0..7)
{0xFFD080B9+4i} RSCAN1RFCC{i}LH (i=0..7)
{0xFFD080D8+4i} RSCAN1RFSTS{i} 32-bit (i=0..7)
{0xFFD080D8+4i} RSCAN1RFSTS{i}L 16-bit (i=0..7)
{0xFFD080D8+4i} RSCAN1RFSTS{i}LL (i=0..7)
{0xFFD080D9+4i} RSCAN1RFSTS{i}LH ro (i=0..7)
{0xFFD080F8+4i} RSCAN1RFPCTR{i} 32-bit wo (i=0..7)
{0xFFD080F8+4i} RSCAN1RFPCTR{i}L 16-bit wo (i=0..7)
{0xFFD080F8+4i} RSCAN1RFPCTR{i}LL wo (i=0..7)
{0xFFD08118+4i} RSCAN1CFCC{i} 32-bit (i=0..2)
{0xFFD08118+4i} RSCAN1CFCC{i}L 16-bit (i=0..2)
{0xFFD08118+4i} RSCAN1CFCC{i}LL (i=0..2)
{0xFFD08119+4i} RSCAN1CFCC{i}LH (i=0..2)
{0xFFD0811A+4i} RSCAN1CFCC{i}H 16-bit (i=0..2)
{0xFFD0811A+4i} RSCAN1CFCC{i}HL (i=0..2)
{0xFFD0811B+4i} RSCAN1CFCC{i}HH (i=0..2)
{0xFFD08178+4i} RSCAN1CFSTS{i} 32-bit (i=0..2)
{0xFFD08178+4i} RSCAN1CFSTS{i}L 16-bit (i=0..2)
{0xFFD08178+4i} RSCAN1CFSTS{i}LL (i=0..2)
{0xFFD08179+4i} RSCAN1CFSTS{i}LH ro (i=0..2)
{0xFFD081D8+4i} RSCAN1CFPCTR{i} 32-bit wo (i=0..2)
{0xFFD081D8+4i} RSCAN1CFPCTR{i}L 16-bit wo (i=0..2)
{0xFFD081D8+4i} RSCAN1CFPCTR{i}LL wo (i=0..2)
0xFFD08238 RSCAN1FESTS 32-bit ro
0xFFD08238 RSCAN1FESTSL 16-bit ro
0xFFD08238 RSCAN1FESTSLL ro
0xFFD08239 RSCAN1FESTSLH ro
0xFFD0823C RSCAN1FFSTS 32-bit ro
0xFFD0823C RSCAN1FFSTSL 16-bit ro
0xFFD0823C RSCAN1FFSTSLL ro
0xFFD0823D RSCAN1FFSTSLH ro
0xFFD08240 RSCAN1FMSTS 32-bit ro
0xFFD08240 RSCAN1FMSTSL 16-bit ro
0xFFD08240 RSCAN1FMSTSLL ro
0xFFD08241 RSCAN1FMSTSLH ro
0xFFD08244 RSCAN1RFISTS 32-bit ro
0xFFD08244 RSCAN1RFISTSL 16-bit ro
0xFFD08244 RSCAN1RFISTSLL ro
0xFFD08248 RSCAN1CFRISTS 32-bit ro
0xFFD08248 RSCAN1CFRISTSL 16-bit ro
0xFFD08248 RSCAN1CFRISTSLL ro
0xFFD0824C RSCAN1CFTISTS 32-bit ro
0xFFD0824C RSCAN1CFTISTSL 16-bit ro
0xFFD0824C RSCAN1CFTISTSLL ro
{0xFFD08250+i} RSCAN1TMC{i} (i=0..15)
{0xFFD082D0+i} RSCAN1TMSTS{i} (i=0..15)
0xFFD08350 RSCAN1TMTRSTS0 32-bit ro
0xFFD08350 RSCAN1TMTRSTS0L 16-bit ro
0xFFD08350 RSCAN1TMTRSTS0LL ro
0xFFD08351 RSCAN1TMTRSTS0LH ro
0xFFD08360 RSCAN1TMTARSTS0 32-bit ro
0xFFD08360 RSCAN1TMTARSTS0L 16-bit ro
0xFFD08360 RSCAN1TMTARSTS0LL ro
0xFFD08361 RSCAN1TMTARSTS0LH ro
0xFFD08370 RSCAN1TMTCSTS0 32-bit ro
0xFFD08370 RSCAN1TMTCSTS0L 16-bit ro
0xFFD08370 RSCAN1TMTCSTS0LL ro
0xFFD08371 RSCAN1TMTCSTS0LH ro
0xFFD08380 RSCAN1TMTASTS0 32-bit ro
0xFFD08380 RSCAN1TMTASTS0L 16-bit ro
0xFFD08380 RSCAN1TMTASTS0LL ro
0xFFD08381 RSCAN1TMTASTS0LH ro
0xFFD08390 RSCAN1TMIEC0 32-bit
0xFFD08390 RSCAN1TMIEC0L 16-bit
0xFFD08390 RSCAN1TMIEC0LL
0xFFD08391 RSCAN1TMIEC0LH
0xFFD083A0 RSCAN1TXQCC6 32-bit
0xFFD083A0 RSCAN1TXQCC6L 16-bit
0xFFD083A0 RSCAN1TXQCC6LL
0xFFD083A1 RSCAN1TXQCC6LH
0xFFD083C0 RSCAN1TXQSTS6 32-bit
0xFFD083C0 RSCAN1TXQSTS6L 16-bit
0xFFD083C0 RSCAN1TXQSTS6LL
0xFFD083E0 RSCAN1TXQPCTR6 32-bit wo
0xFFD083E0 RSCAN1TXQPCTR6L 16-bit wo
0xFFD083E0 RSCAN1TXQPCTR6LL wo
0xFFD08400 RSCAN1THLCC6 32-bit
0xFFD08400 RSCAN1THLCC6L 16-bit
0xFFD08400 RSCAN1THLCC6LL
0xFFD08401 RSCAN1THLCC6LH
0xFFD08420 RSCAN1THLSTS6 32-bit
0xFFD08420 RSCAN1THLSTS6L 16-bit
0xFFD08420 RSCAN1THLSTS6LL
0xFFD08421 RSCAN1THLSTS6LH ro
0xFFD08440 RSCAN1THLPCTR6 32-bit wo
0xFFD08440 RSCAN1THLPCTR6L 16-bit wo
0xFFD08440 RSCAN1THLPCTR6LL wo
0xFFD08460 RSCAN1GTINTSTS0 32-bit ro
0xFFD08460 RSCAN1GTINTSTS0L 16-bit ro
0xFFD08460 RSCAN1GTINTSTS0LL ro
0xFFD08468 RSCAN1GTSTCFG 32-bit
0xFFD08468 RSCAN1GTSTCFGL 16-bit
0xFFD08468 RSCAN1GTSTCFGLL
0xFFD0846A RSCAN1GTSTCFGH 16-bit
0xFFD0846A RSCAN1GTSTCFGHL
0xFFD0846C RSCAN1GTSTCTR 32-bit
0xFFD0846C RSCAN1GTSTCTRL 16-bit
0xFFD0846C RSCAN1GTSTCTRLL
0xFFD0847C RSCAN1GLOCKK 32-bit wo
0xFFD0847C RSCAN1GLOCKKL 16-bit wo
{0xFFD08500+0x10*i} RSCAN1GAFLID{i} 32-bit (i=0..15)
{0xFFD08500+0x10*i} RSCAN1GAFLID{i}L 16-bit (i=0..15)
{0xFFD08500+0x10*i} RSCAN1GAFLID{i}LL (i=0..15)
{0xFFD08501+0x10*i} RSCAN1GAFLID{i}LH (i=0..15)
{0xFFD08502+0x10*i} RSCAN1GAFLID{i}H 16-bit (i=0..15)
{0xFFD08502+0x10*i} RSCAN1GAFLID{i}HL (i=0..15)
{0xFFD08503+0x10*i} RSCAN1GAFLID{i}HH (i=0..15)
{0xFFD08504+0x10*i} RSCAN1GAFLM{i} 32-bit (i=0..15)
{0xFFD08504+0x10*i} RSCAN1GAFLM{i}L 16-bit (i=0..15)
{0xFFD08504+0x10*i} RSCAN1GAFLM{i}LL (i=0..15)
{0xFFD08505+0x10*i} RSCAN1GAFLM{i}LH (i=0..15)
{0xFFD08506+0x10*i} RSCAN1GAFLM{i}H 16-bit (i=0..15)
{0xFFD08506+0x10*i} RSCAN1GAFLM{i}HL (i=0..15)
{0xFFD08507+0x10*i} RSCAN1GAFLM{i}HH (i=0..15)
{0xFFD08508+0x10*i} RSCAN1GAFLP{i:02} 32-bit (i=0..9)
{0xFFD08508+0x10*i} RSCAN1GAFLP{i:02}L 16-bit (i=0..9)
{0xFFD08509+0x10*i} RSCAN1GAFLP{i:02}LH (i=0..9)
{0xFFD0850A+0x10*i} RSCAN1GAFLP{i:02}H 16-bit (i=0..9)
{0xFFD0850A+0x10*i} RSCAN1GAFLP{i:02}HL (i=0..9)
{0xFFD0850B+0x10*i} RSCAN1GAFLP{i:02}HH (i=0..9)
0xFFD0850C RSCAN1GAFLP10 32-bit
0xFFD0850C RSCAN1GAFLP10L 16-bit
{0xFFD0846C+0x10*i} RSCAN1GAFLP{i}LL (i=10..19)
0xFFD0850D RSCAN1GAFLP10LH
0xFFD0851C RSCAN1GAFLP11 32-bit
0xFFD0851C RSCAN1GAFLP11L 16-bit
0xFFD0851D RSCAN1GAFLP11LH
0xFFD0852C RSCAN1GAFLP12 32-bit
0xFFD0852C RSCAN1GAFLP12L 16-bit
0xFFD0852D RSCAN1GAFLP12LH
0xFFD0853C RSCAN1GAFLP13 32-bit
0xFFD0853C RSCAN1GAFLP13L 16-bit
0xFFD0853D RSCAN1GAFLP13LH
0xFFD0854C RSCAN1GAFLP14 32-bit
0xFFD0854C RSCAN1GAFLP14L 16-bit
0xFFD0854D RSCAN1GAFLP14LH
0xFFD0855C RSCAN1GAFLP15 32-bit
0xFFD0855C RSCAN1GAFLP15L 16-bit
0xFFD0855D RSCAN1GAFLP15LH
{0xFFD0846C+0x10*i} RSCAN1GAFLP{i} 32-bit (i=16..19)
{0xFFD0846C+0x10*i} RSCAN1GAFLP{i}L 16-bit (i=16..19)
{0xFFD0846D+0x10*i} RSCAN1GAFLP{i}LH (i=16..19)
0xFFD085A8 RSCAN1GAFLP010 32-bit
0xFFD085A8 RSCAN1GAFLP010L 16-bit
0xFFD085A9 RSCAN1GAFLP010LH
{0xFFD0850A+0x10*i} RSCAN1GAFLP{i:03}H 16-bit (i=10..15)
{0xFFD0850A+0x10*i} RSCAN1GAFLP{i:03}HL (i=10..15)
{0xFFD0850B+0x10*i} RSCAN1GAFLP{i:03}HH (i=10..15)
{0xFFD07ECC+0x10*i} RSCAN1GAFLP{i} 32-bit (i=110..115)
{0xFFD07ECC+0x10*i} RSCAN1GAFLP{i}L 16-bit (i=110..115)
{0xFFD07ECC+0x10*i} RSCAN1GAFLP{i}LL (i=110..115)
{0xFFD07ECD+0x10*i} RSCAN1GAFLP{i}LH (i=110..115)
0xFFD085B8 RSCAN1GAFLP011 32-bit
0xFFD085B8 RSCAN1GAFLP011L 16-bit
0xFFD085B9 RSCAN1GAFLP011LH
0xFFD085C8 RSCAN1GAFLP012 32-bit
0xFFD085C8 RSCAN1GAFLP012L 16-bit
0xFFD085C9 RSCAN1GAFLP012LH
0xFFD085D8 RSCAN1GAFLP013 32-bit
0xFFD085D8 RSCAN1GAFLP013L 16-bit
0xFFD085D9 RSCAN1GAFLP013LH
0xFFD085E8 RSCAN1GAFLP014 32-bit
0xFFD085E8 RSCAN1GAFLP014L 16-bit
0xFFD085E9 RSCAN1GAFLP014LH
0xFFD085F8 RSCAN1GAFLP015 32-bit
0xFFD085F8 RSCAN1GAFLP015L 16-bit
0xFFD085F9 RSCAN1GAFLP015LH
{0xFFD08600+0x10*i} RSCAN1RMID{i} 32-bit ro (i=0..15)
{0xFFD08600+0x10*i} RSCAN1RMID{i}L 16-bit ro (i=0..15)
{0xFFD08600+0x10*i} RSCAN1RMID{i}LL ro (i=0..15)
{0xFFD08601+0x10*i} RSCAN1RMID{i}LH ro (i=0..15)
{0xFFD08602+0x10*i} RSCAN1RMID{i}H 16-bit ro (i=0..15)
{0xFFD08602+0x10*i} RSCAN1RMID{i}HL ro (i=0..15)
{0xFFD08603+0x10*i} RSCAN1RMID{i}HH ro (i=0..15)
{0xFFD08604+0x10*i} RSCAN1RMPTR{i} 32-bit ro (i=0..15)
{0xFFD08604+0x10*i} RSCAN1RMPTR{i}L 16-bit ro (i=0..15)
{0xFFD08604+0x10*i} RSCAN1RMPTR{i}LL ro (i=0..15)
{0xFFD08605+0x10*i} RSCAN1RMPTR{i}LH ro (i=0..15)
{0xFFD08606+0x10*i} RSCAN1RMPTR{i}H 16-bit ro (i=0..15)
{0xFFD08606+0x10*i} RSCAN1RMPTR{i}HL ro (i=0..15)
{0xFFD08607+0x10*i} RSCAN1RMPTR{i}HH ro (i=0..15)
{0xFFD08608+0x10*i} RSCAN1RMDF{i:02} 32-bit ro (i=0..9)
{0xFFD08608+0x10*i} RSCAN1RMDF{i:02}L 16-bit ro (i=0..9)
{0xFFD08608+0x10*i} RSCAN1RMDF{i:02}LL ro (i=0..9)
{0xFFD08609+0x10*i} RSCAN1RMDF{i:02}LH ro (i=0..9)
{0xFFD0860A+0x10*i} RSCAN1RMDF{i:02}H 16-bit ro (i=0..9)
{0xFFD0860A+0x10*i} RSCAN1RMDF{i:02}HL ro (i=0..9)
{0xFFD0860B+0x10*i} RSCAN1RMDF{i:02}HH ro (i=0..9)
0xFFD0860C RSCAN1RMDF10 32-bit ro
0xFFD0860C RSCAN1RMDF10L 16-bit ro
0xFFD0860C RSCAN1RMDF10LL ro
0xFFD0860D RSCAN1RMDF10LH ro
0xFFD0860E RSCAN1RMDF10H 16-bit ro
0xFFD0860E RSCAN1RMDF10HL ro
0xFFD0860F RSCAN1RMDF10HH ro
0xFFD0861C RSCAN1RMDF11 32-bit ro
0xFFD0861C RSCAN1RMDF11L 16-bit ro
0xFFD0861C RSCAN1RMDF11LL ro
0xFFD0861D RSCAN1RMDF11LH ro
0xFFD0861E RSCAN1RMDF11H 16-bit ro
0xFFD0861E RSCAN1RMDF11HL ro
0xFFD0861F RSCAN1RMDF11HH ro
0xFFD0862C RSCAN1RMDF12 32-bit ro
0xFFD0862C RSCAN1RMDF12L 16-bit ro
0xFFD0862C RSCAN1RMDF12LL ro
0xFFD0862D RSCAN1RMDF12LH ro
0xFFD0862E RSCAN1RMDF12H 16-bit ro
0xFFD0862E RSCAN1RMDF12HL ro
0xFFD0862F RSCAN1RMDF12HH ro
0xFFD0863C RSCAN1RMDF13 32-bit ro
0xFFD0863C RSCAN1RMDF13L 16-bit ro
0xFFD0863C RSCAN1RMDF13LL ro
0xFFD0863D RSCAN1RMDF13LH ro
0xFFD0863E RSCAN1RMDF13H 16-bit ro
0xFFD0863E RSCAN1RMDF13HL ro
0xFFD0863F RSCAN1RMDF13HH ro
0xFFD0864C RSCAN1RMDF14 32-bit ro
0xFFD0864C RSCAN1RMDF14L 16-bit ro
0xFFD0864C RSCAN1RMDF14LL ro
0xFFD0864D RSCAN1RMDF14LH ro
0xFFD0864E RSCAN1RMDF14H 16-bit ro
0xFFD0864E RSCAN1RMDF14HL ro
0xFFD0864F RSCAN1RMDF14HH ro
0xFFD0865C RSCAN1RMDF15 32-bit ro
0xFFD0865C RSCAN1RMDF15L 16-bit ro
0xFFD0865C RSCAN1RMDF15LL ro
0xFFD0865D RSCAN1RMDF15LH ro
0xFFD0865E RSCAN1RMDF15H 16-bit ro
0xFFD0865E RSCAN1RMDF15HL ro
0xFFD0865F RSCAN1RMDF15HH ro
{0xFFD0856C+0x10*i} RSCAN1RMDF{i} 32-bit ro (i=16..19)
{0xFFD0856C+0x10*i} RSCAN1RMDF{i}L 16-bit ro (i=16..19)
{0xFFD0856C+0x10*i} RSCAN1RMDF{i}LL ro (i=16..19)
{0xFFD0856D+0x10*i} RSCAN1RMDF{i}LH ro (i=16..19)
{0xFFD0856E+0x10*i} RSCAN1RMDF{i}H 16-bit ro (i=16..19)
{0xFFD0856E+0x10*i} RSCAN1RMDF{i}HL ro (i=16..19)
{0xFFD0856F+0x10*i} RSCAN1RMDF{i}HH ro (i=16..19)
0xFFD086A8 RSCAN1RMDF010 32-bit ro
0xFFD086A8 RSCAN1RMDF010L 16-bit ro
0xFFD086A8 RSCAN1RMDF010LL ro
0xFFD086A9 RSCAN1RMDF010LH ro
0xFFD086AA RSCAN1RMDF010H 16-bit ro
0xFFD086AA RSCAN1RMDF010HL ro
0xFFD086AB RSCAN1RMDF010HH ro
{0xFFD07FCC+0x10*i} RSCAN1RMDF{i} 32-bit ro (i=110..115)
{0xFFD07FCC+0x10*i} RSCAN1RMDF{i}L 16-bit ro (i=110..115)
{0xFFD07FCC+0x10*i} RSCAN1RMDF{i}LL ro (i=110..115)
{0xFFD07FCD+0x10*i} RSCAN1RMDF{i}LH ro (i=110..115)
{0xFFD07FCE+0x10*i} RSCAN1RMDF{i}H 16-bit ro (i=110..115)
{0xFFD07FCE+0x10*i} RSCAN1RMDF{i}HL ro (i=110..115)
{0xFFD07FCF+0x10*i} RSCAN1RMDF{i}HH ro (i=110..115)
0xFFD086B8 RSCAN1RMDF011 32-bit ro
0xFFD086B8 RSCAN1RMDF011L 16-bit ro
0xFFD086B8 RSCAN1RMDF011LL ro
0xFFD086B9 RSCAN1RMDF011LH ro
0xFFD086BA RSCAN1RMDF011H 16-bit ro
0xFFD086BA RSCAN1RMDF011HL ro
0xFFD086BB RSCAN1RMDF011HH ro
0xFFD086C8 RSCAN1RMDF012 32-bit ro
0xFFD086C8 RSCAN1RMDF012L 16-bit ro
0xFFD086C8 RSCAN1RMDF012LL ro
0xFFD086C9 RSCAN1RMDF012LH ro
0xFFD086CA RSCAN1RMDF012H 16-bit ro
0xFFD086CA RSCAN1RMDF012HL ro
0xFFD086CB RSCAN1RMDF012HH ro
0xFFD086D8 RSCAN1RMDF013 32-bit ro
0xFFD086D8 RSCAN1RMDF013L 16-bit ro
0xFFD086D8 RSCAN1RMDF013LL ro
0xFFD086D9 RSCAN1RMDF013LH ro
0xFFD086DA RSCAN1RMDF013H 16-bit ro
0xFFD086DA RSCAN1RMDF013HL ro
0xFFD086DB RSCAN1RMDF013HH ro
0xFFD086E8 RSCAN1RMDF014 32-bit ro
0xFFD086E8 RSCAN1RMDF014L 16-bit ro
0xFFD086E8 RSCAN1RMDF014LL ro
0xFFD086E9 RSCAN1RMDF014LH ro
0xFFD086EA RSCAN1RMDF014H 16-bit ro
0xFFD086EA RSCAN1RMDF014HL ro
0xFFD086EB RSCAN1RMDF014HH ro
0xFFD086F8 RSCAN1RMDF015 32-bit ro
0xFFD086F8 RSCAN1RMDF015L 16-bit ro
0xFFD086F8 RSCAN1RMDF015LL ro
0xFFD086F9 RSCAN1RMDF015LH ro
0xFFD086FA RSCAN1RMDF015H 16-bit ro
0xFFD086FA RSCAN1RMDF015HL ro
0xFFD086FB RSCAN1RMDF015HH ro
{0xFFD08E00+0x10*i} RSCAN1RFID{i} 32-bit ro (i=0..7)
{0xFFD08E00+0x10*i} RSCAN1RFID{i}L 16-bit ro (i=0..7)
{0xFFD08E00+0x10*i} RSCAN1RFID{i}LL ro (i=0..7)
{0xFFD08E01+0x10*i} RSCAN1RFID{i}LH ro (i=0..7)
{0xFFD08E02+0x10*i} RSCAN1RFID{i}H 16-bit ro (i=0..7)
{0xFFD08E02+0x10*i} RSCAN1RFID{i}HL ro (i=0..7)
{0xFFD08E03+0x10*i} RSCAN1RFID{i}HH ro (i=0..7)
{0xFFD08E04+0x10*i} RSCAN1RFPTR{i} 32-bit ro (i=0..7)
{0xFFD08E04+0x10*i} RSCAN1RFPTR{i}L 16-bit ro (i=0..7)
{0xFFD08E04+0x10*i} RSCAN1RFPTR{i}LL ro (i=0..7)
{0xFFD08E05+0x10*i} RSCAN1RFPTR{i}LH ro (i=0..7)
{0xFFD08E06+0x10*i} RSCAN1RFPTR{i}H 16-bit ro (i=0..7)
{0xFFD08E06+0x10*i} RSCAN1RFPTR{i}HL ro (i=0..7)
{0xFFD08E07+0x10*i} RSCAN1RFPTR{i}HH ro (i=0..7)
{0xFFD08E08+0x10*i} RSCAN1RFDF{i:02} 32-bit ro (i=0..7)
{0xFFD08E08+0x10*i} RSCAN1RFDF{i:02}L 16-bit ro (i=0..7)
{0xFFD08E08+0x10*i} RSCAN1RFDF{i:02}LL ro (i=0..7)
{0xFFD08E09+0x10*i} RSCAN1RFDF{i:02}LH ro (i=0..7)
{0xFFD08E0A+0x10*i} RSCAN1RFDF{i:02}H 16-bit ro (i=0..7)
{0xFFD08E0A+0x10*i} RSCAN1RFDF{i:02}HL ro (i=0..7)
{0xFFD08E0B+0x10*i} RSCAN1RFDF{i:02}HH ro (i=0..7)
{0xFFD08D6C+0x10*i} RSCAN1RFDF{i} 32-bit ro (i=10..17)
{0xFFD08D6C+0x10*i} RSCAN1RFDF{i}L 16-bit ro (i=10..17)
{0xFFD08D6C+0x10*i} RSCAN1RFDF{i}LL ro (i=10..17)
{0xFFD08D6D+0x10*i} RSCAN1RFDF{i}LH ro (i=10..17)
{0xFFD08D6E+0x10*i} RSCAN1RFDF{i}H 16-bit ro (i=10..17)
{0xFFD08D6E+0x10*i} RSCAN1RFDF{i}HL ro (i=10..17)
{0xFFD08D6F+0x10*i} RSCAN1RFDF{i}HH ro (i=10..17)
{0xFFD08E80+0x10*i} RSCAN1CFID{i} 32-bit (i=0..2)
{0xFFD08E80+0x10*i} RSCAN1CFID{i}L 16-bit (i=0..2)
{0xFFD08E80+0x10*i} RSCAN1CFID{i}LL (i=0..2)
{0xFFD08E81+0x10*i} RSCAN1CFID{i}LH (i=0..2)
{0xFFD08E82+0x10*i} RSCAN1CFID{i}H 16-bit (i=0..2)
{0xFFD08E82+0x10*i} RSCAN1CFID{i}HL (i=0..2)
{0xFFD08E83+0x10*i} RSCAN1CFID{i}HH (i=0..2)
{0xFFD08E84+0x10*i} RSCAN1CFPTR{i} 32-bit (i=0..2)
{0xFFD08E84+0x10*i} RSCAN1CFPTR{i}L 16-bit (i=0..2)
{0xFFD08E84+0x10*i} RSCAN1CFPTR{i}LL (i=0..2)
{0xFFD08E85+0x10*i} RSCAN1CFPTR{i}LH (i=0..2)
{0xFFD08E86+0x10*i} RSCAN1CFPTR{i}H 16-bit (i=0..2)
{0xFFD08E86+0x10*i} RSCAN1CFPTR{i}HL (i=0..2)
{0xFFD08E87+0x10*i} RSCAN1CFPTR{i}HH (i=0..2)
{0xFFD08E88+0x10*i} RSCAN1CFDF{i:02} 32-bit (i=0..2)
{0xFFD08E88+0x10*i} RSCAN1CFDF{i:02}L 16-bit (i=0..2)
{0xFFD08E88+0x10*i} RSCAN1CFDF{i:02}LL (i=0..2)
{0xFFD08E89+0x10*i} RSCAN1CFDF{i:02}LH (i=0..2)
{0xFFD08E8A+0x10*i} RSCAN1CFDF{i:02}H 16-bit (i=0..2)
{0xFFD08E8A+0x10*i} RSCAN1CFDF{i:02}HL (i=0..2)
{0xFFD08E8B+0x10*i} RSCAN1CFDF{i:02}HH (i=0..2)
{0xFFD08DEC+0x10*i} RSCAN1CFDF{i} 32-bit (i=10..12)
{0xFFD08DEC+0x10*i} RSCAN1CFDF{i}L 16-bit (i=10..12)
{0xFFD08DEC+0x10*i} RSCAN1CFDF{i}LL (i=10..12)
{0xFFD08DED+0x10*i} RSCAN1CFDF{i}LH (i=10..12)
{0xFFD08DEE+0x10*i} RSCAN1CFDF{i}H 16-bit (i=10..12)
{0xFFD08DEE+0x10*i} RSCAN1CFDF{i}HL (i=10..12)
{0xFFD08DEF+0x10*i} RSCAN1CFDF{i}HH (i=10..12)
{0xFFD09000+0x10*i} RSCAN1TMID{i} 32-bit (i=0..15)
{0xFFD09000+0x10*i} RSCAN1TMID{i}L 16-bit (i=0..15)
{0xFFD09000+0x10*i} RSCAN1TMID{i}LL (i=0..15)
{0xFFD09001+0x10*i} RSCAN1TMID{i}LH (i=0..15)
{0xFFD09002+0x10*i} RSCAN1TMID{i}H 16-bit (i=0..15)
{0xFFD09002+0x10*i} RSCAN1TMID{i}HL (i=0..15)
{0xFFD09003+0x10*i} RSCAN1TMID{i}HH (i=0..15)
{0xFFD09004+0x10*i} RSCAN1TMPTR{i} 32-bit (i=0..15)
{0xFFD09006+0x10*i} RSCAN1TMPTR{i}H 16-bit (i=0..15)
{0xFFD09006+0x10*i} RSCAN1TMPTR{i}HL (i=0..15)
{0xFFD09007+0x10*i} RSCAN1TMPTR{i}HH (i=0..15)
{0xFFD09008+0x10*i} RSCAN1TMDF{i:02} 32-bit (i=0..9)
{0xFFD09008+0x10*i} RSCAN1TMDF{i:02}L 16-bit (i=0..9)
{0xFFD09008+0x10*i} RSCAN1TMDF{i:02}LL (i=0..9)
{0xFFD09009+0x10*i} RSCAN1TMDF{i:02}LH (i=0..9)
{0xFFD0900A+0x10*i} RSCAN1TMDF{i:02}H 16-bit (i=0..9)
{0xFFD0900A+0x10*i} RSCAN1TMDF{i:02}HL (i=0..9)
{0xFFD0900B+0x10*i} RSCAN1TMDF{i:02}HH (i=0..9)
{0xFFD08F6C+0x10*i} RSCAN1TMDF{i} 32-bit (i=10..12)
{0xFFD08F6C+0x10*i} RSCAN1TMDF{i}L 16-bit (i=10..12)
{0xFFD08F6C+0x10*i} RSCAN1TMDF{i}LL (i=10..12)
{0xFFD08F6D+0x10*i} RSCAN1TMDF{i}LH (i=10..12)
{0xFFD08F6E+0x10*i} RSCAN1TMDF{i}H 16-bit (i=10..12)
{0xFFD08F6E+0x10*i} RSCAN1TMDF{i}HL (i=10..12)
{0xFFD08F6F+0x10*i} RSCAN1TMDF{i}HH (i=10..12)
