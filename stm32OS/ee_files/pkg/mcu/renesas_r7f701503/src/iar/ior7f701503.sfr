# ior7f701503 register map
Registers from a debugger description file.
Registers are 8-bit, access not given, no defined reset value unless marked. A register's access mark holds for its fields unless they carry their own. Addresses are absolute; registers are grouped by the start of their names; lines under a group give offsets from that group; [hi:lo] are bit positions; {n}, {i} and the like mark numbered series; 'fields as' and 'values as' point back to an identical list; <NAME> marks a mode.

## SELB
0xFFC01000 SELB_INTC1 16-bit
0xFFC01004 SELB_INTC2 16-bit
0xFFC78000 SELB_READTEST 16-bit
0xFFE24000 SELB_TAUD0I 16-bit
0xFFE54000 SELB_TAUJ0I

## FCLA0CTL0
0xFFC34000 FCLA0CTL0_NMI
0xFFC34020 FCLA0CTL0_INTPL
0xFFC34040 FCLA0CTL0_INTPH
0xFFC34060 FCLA0CTL0_ADC0
0xFFC34080 FCLA0CTL0_ADC1

## FCLA0CTL1
0xFFC34024 FCLA0CTL1_INTPL
0xFFC34044 FCLA0CTL1_INTPH
0xFFC34064 FCLA0CTL1_ADC0
0xFFC34084 FCLA0CTL1_ADC1

## FCLA0CTL2
0xFFC34028 FCLA0CTL2_INTPL
0xFFC34048 FCLA0CTL2_INTPH
0xFFC34068 FCLA0CTL2_ADC0
0xFFC34088 FCLA0CTL2_ADC1

## FCLA0CTL3
0xFFC3402C FCLA0CTL3_INTPL
0xFFC3404C FCLA0CTL3_INTPH

## FCLA0CTL4
0xFFC34030 FCLA0CTL4_INTPL
0xFFC34050 FCLA0CTL4_INTPH

## FCLA0CTL5
0xFFC34034 FCLA0CTL5_INTPL
0xFFC34054 FCLA0CTL5_INTPH

## FCLA0CTL6
0xFFC34038 FCLA0CTL6_INTPL
0xFFC34058 FCLA0CTL6_INTPH

## FCLA0CTL7
0xFFC3403C FCLA0CTL7_INTPL
0xFFC3405C FCLA0CTL7_INTPH

## MGDGRSCTL
0xFFC49100 MGDGRSCTL_VCI 32-bit wo
0xFFC49100 MGDGRSCTL_VCIL 16-bit wo
0xFFC49100 MGDGRSCTL_VCILL wo
0xFFC49200 MGDGRSCTL_PE1 32-bit wo
0xFFC49200 MGDGRSCTL_PE1L 16-bit wo
0xFFC49200 MGDGRSCTL_PE1LL wo
0xFFC49300 MGDGRSCTL_PE2 32-bit wo
0xFFC49300 MGDGRSCTL_PE2L 16-bit wo
0xFFC49300 MGDGRSCTL_PE2LL wo

## MGDGRSSTAT
0xFFC49104 MGDGRSSTAT_VCI 32-bit ro
0xFFC49104 MGDGRSSTAT_VCIL 16-bit ro
0xFFC49104 MGDGRSSTAT_VCILL ro
0xFFC49204 MGDGRSSTAT_PE1 32-bit ro
0xFFC49204 MGDGRSSTAT_PE1L 16-bit ro
0xFFC49204 MGDGRSSTAT_PE1LL ro
0xFFC49304 MGDGRSSTAT_PE2 32-bit ro
0xFFC49304 MGDGRSSTAT_PE2L 16-bit ro
0xFFC49304 MGDGRSSTAT_PE2LL ro

## MGDGRSTYPE
0xFFC4910C MGDGRSTYPE_VCI 32-bit ro
0xFFC4910C MGDGRSTYPE_VCIL 16-bit ro
0xFFC4910C MGDGRSTYPE_VCILL ro
0xFFC4910D MGDGRSTYPE_VCILH ro
0xFFC4920C MGDGRSTYPE_PE1 32-bit ro
0xFFC4920C MGDGRSTYPE_PE1L 16-bit ro
0xFFC4920C MGDGRSTYPE_PE1LL ro
0xFFC4920D MGDGRSTYPE_PE1LH ro
0xFFC4930C MGDGRSTYPE_PE2 32-bit ro
0xFFC4930C MGDGRSTYPE_PE2L 16-bit ro
0xFFC4930C MGDGRSTYPE_PE2LL ro
0xFFC4930D MGDGRSTYPE_PE2LH ro

## IDECCCTL
0xFFC60400 IDECCCTL_PE1 32-bit
0xFFC60400 IDECCCTL_PE1L 16-bit
0xFFC60600 IDECCCTL_PE2 32-bit
0xFFC60600 IDECCCTL_PE2L 16-bit

## Notices in the file
Copyright(C) 2014 Renesas
