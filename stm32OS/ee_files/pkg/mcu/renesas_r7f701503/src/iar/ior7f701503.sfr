# ior7f701503 register map
Registers are 8-bit, access not given, no defined reset value unless marked. A register's access mark holds for its fields unless they carry their own. Addresses are absolute; registers are grouped by the start of their names; [hi:lo] are bit positions; {n}, {i} and the like mark numbered series.

## GR1STEADR1
0xFFC64254 GR1STEADR1_VCI 32-bit ro
0xFFC64254 GR1STEADR1_VCIL 16-bit ro
0xFFC64254 GR1STEADR1_VCILL ro
0xFFC64255 GR1STEADR1_VCILH ro
0xFFC64256 GR1STEADR1_VCIH 16-bit ro
0xFFC64256 GR1STEADR1_VCIHL ro
0xFFC64454 GR1STEADR1_PE1 32-bit ro
0xFFC64454 GR1STEADR1_PE1L 16-bit ro
0xFFC64454 GR1STEADR1_PE1LL ro
0xFFC64455 GR1STEADR1_PE1LH ro
0xFFC64456 GR1STEADR1_PE1H 16-bit ro
0xFFC64456 GR1STEADR1_PE1HL ro
0xFFC64654 GR1STEADR1_PE2 32-bit ro
0xFFC64654 GR1STEADR1_PE2L 16-bit ro
0xFFC64654 GR1STEADR1_PE2LL ro
0xFFC64655 GR1STEADR1_PE2LH ro
0xFFC64656 GR1STEADR1_PE2H 16-bit ro
0xFFC64656 GR1STEADR1_PE2HL ro

## LRTSTCTL
0xFFC65004 LRTSTCTL_PE1 32-bit
0xFFC65004 LRTSTCTL_PE1L 16-bit
0xFFC65024 LRTSTCTL_PE2 32-bit
0xFFC65024 LRTSTCTL_PE2L 16-bit

## LRTDATBF0
0xFFC65008 LRTDATBF0_PE1 32-bit ro
0xFFC65028 LRTDATBF0_PE2 32-bit ro

## LRTDATBF1
0xFFC6500C LRTDATBF1_PE1 32-bit ro
0xFFC6502C LRTDATBF1_PE2 32-bit ro

## LRECCCTL
0xFFC65400 LRECCCTL_PE1 32-bit
0xFFC65400 LRECCCTL_PE1L 16-bit
0xFFC65600 LRECCCTL_PE2 32-bit
0xFFC65600 LRECCCTL_PE2L 16-bit

## LRERRINT
0xFFC65404 LRERRINT_PE1 32-bit
0xFFC65404 LRERRINT_PE1L 16-bit
0xFFC65404 LRERRINT_PE1LL
0xFFC65604 LRERRINT_PE2 32-bit
0xFFC65604 LRERRINT_PE2L 16-bit
0xFFC65604 LRERRINT_PE2LL

## LRSTCLR
0xFFC65408 LRSTCLR_PE1 32-bit wo
0xFFC65408 LRSTCLR_PE1L 16-bit wo
0xFFC65408 LRSTCLR_PE1LL wo
0xFFC65608 LRSTCLR_PE2 32-bit wo
0xFFC65608 LRSTCLR_PE2L 16-bit wo
0xFFC65608 LRSTCLR_PE2LL wo

## LROVFSTR
0xFFC6540C LROVFSTR_PE1 32-bit ro
0xFFC6540C LROVFSTR_PE1L 16-bit ro
0xFFC6540C LROVFSTR_PE1LL ro
0xFFC6560C LROVFSTR_PE2 32-bit ro
0xFFC6560C LROVFSTR_PE2L 16-bit ro
0xFFC6560C LROVFSTR_PE2LL ro

## LR1STERSTR
0xFFC65410 LR1STERSTR_PE1 32-bit ro
0xFFC65410 LR1STERSTR_PE1L 16-bit ro
0xFFC65410 LR1STERSTR_PE1LL ro
0xFFC65411 LR1STERSTR_PE1LH ro
0xFFC65412 LR1STERSTR_PE1H 16-bit ro
0xFFC65412 LR1STERSTR_PE1HL ro
0xFFC65413 LR1STERSTR_PE1HH ro
0xFFC65610 LR1STERSTR_PE2 32-bit ro
0xFFC65610 LR1STERSTR_PE2L 16-bit ro
0xFFC65610 LR1STERSTR_PE2LL ro
0xFFC65611 LR1STERSTR_PE2LH ro
0xFFC65612 LR1STERSTR_PE2H 16-bit ro
0xFFC65612 LR1STERSTR_PE2HL ro
0xFFC65613 LR1STERSTR_PE2HH ro

## LR1STEADR0
0xFFC65450 LR1STEADR0_PE1 32-bit ro
0xFFC65450 LR1STEADR0_PE1L 16-bit ro
0xFFC65450 LR1STEADR0_PE1LL ro
0xFFC65451 LR1STEADR0_PE1LH ro
0xFFC65650 LR1STEADR0_PE2 32-bit ro
0xFFC65650 LR1STEADR0_PE2L 16-bit ro
0xFFC65650 LR1STEADR0_PE2LL ro
0xFFC65651 LR1STEADR0_PE2LH ro

## LR1STEADR1
0xFFC65454 LR1STEADR1_PE1 32-bit ro
0xFFC65454 LR1STEADR1_PE1L 16-bit ro
0xFFC65454 LR1STEADR1_PE1LL ro
0xFFC65455 LR1STEADR1_PE1LH ro
0xFFC65654 LR1STEADR1_PE2 32-bit ro
0xFFC65654 LR1STEADR1_PE2L 16-bit ro
0xFFC65654 LR1STEADR1_PE2LL ro
0xFFC65655 LR1STEADR1_PE2LH ro

## LR1STEADR2
0xFFC65458 LR1STEADR2_PE1 32-bit ro
0xFFC65458 LR1STEADR2_PE1L 16-bit ro
0xFFC65458 LR1STEADR2_PE1LL ro
0xFFC65459 LR1STEADR2_PE1LH ro
0xFFC65658 LR1STEADR2_PE2 32-bit ro
0xFFC65658 LR1STEADR2_PE2L 16-bit ro
0xFFC65658 LR1STEADR2_PE2LL ro
0xFFC65659 LR1STEADR2_PE2LH ro

## LR1STEADR3
0xFFC6545C LR1STEADR3_PE1 32-bit ro
0xFFC6545C LR1STEADR3_PE1L 16-bit ro
0xFFC6545C LR1STEADR3_PE1LL ro
0xFFC6545D LR1STEADR3_PE1LH ro
0xFFC6565C LR1STEADR3_PE2 32-bit ro
0xFFC6565C LR1STEADR3_PE2L 16-bit ro
0xFFC6565C LR1STEADR3_PE2LL ro
0xFFC6565D LR1STEADR3_PE2LH ro

## CKSC
0xFFF82000 CKSC_AWDTAD_CTL 32-bit
0xFFF82008 CKSC_AWDTAD_ACT 32-bit ro
0xFFF82018 CKSC_AWDTAD_STPM 32-bit
0xFFF82100 CKSC_ATAUJS_CTL 32-bit
0xFFF82108 CKSC_ATAUJS_ACT 32-bit ro
0xFFF82200 CKSC_ATAUJD_CTL 32-bit
0xFFF82208 CKSC_ATAUJD_ACT 32-bit ro
0xFFF82218 CKSC_ATAUJD_STPM 32-bit
0xFFF82300 CKSC_ARTCAS_CTL 32-bit
0xFFF82308 CKSC_ARTCAS_ACT 32-bit ro
0xFFF82400 CKSC_ARTCAD_CTL 32-bit
0xFFF82408 CKSC_ARTCAD_ACT 32-bit ro
0xFFF82418 CKSC_ARTCAD_STPM 32-bit
0xFFF82500 CKSC_AADCAS_CTL 32-bit
0xFFF82508 CKSC_AADCAS_ACT 32-bit ro
0xFFF82600 CKSC_AADCAD_CTL 32-bit
0xFFF82608 CKSC_AADCAD_ACT 32-bit ro
0xFFF82618 CKSC_AADCAD_STPM 32-bit
0xFFF82700 CKSC_AFOUTS_CTL 32-bit
0xFFF82708 CKSC_AFOUTS_ACT 32-bit ro
0xFFF82718 CKSC_AFOUTS_STPM 32-bit
0xFFF8A000 CKSC_CPUCLKS_CTL 32-bit
0xFFF8A008 CKSC_CPUCLKS_ACT 32-bit ro
0xFFF8A100 CKSC_CPUCLKD_CTL 32-bit
0xFFF8A108 CKSC_CPUCLKD_ACT 32-bit ro
0xFFF8A200 CKSC_IPERI1S_CTL 32-bit
0xFFF8A208 CKSC_IPERI1S_ACT 32-bit ro
0xFFF8A300 CKSC_IPERI2S_CTL 32-bit
0xFFF8A308 CKSC_IPERI2S_ACT 32-bit ro
0xFFF8A400 CKSC_ILINS_CTL 32-bit
0xFFF8A408 CKSC_ILINS_ACT 32-bit ro
0xFFF8A500 CKSC_IADCAS_CTL 32-bit
0xFFF8A508 CKSC_IADCAS_ACT 32-bit ro
0xFFF8A600 CKSC_IADCAD_CTL 32-bit
0xFFF8A608 CKSC_IADCAD_ACT 32-bit ro
0xFFF8A800 CKSC_ILIND_CTL 32-bit
0xFFF8A808 CKSC_ILIND_ACT 32-bit ro
0xFFF8A818 CKSC_ILIND_STPM 32-bit
0xFFF8A900 CKSC_ICANS_CTL 32-bit
0xFFF8A908 CKSC_ICANS_ACT 32-bit ro
0xFFF8A918 CKSC_ICANS_STPM 32-bit
0xFFF8AA00 CKSC_ICANOSCD_CTL 32-bit
0xFFF8AA08 CKSC_ICANOSCD_ACT 32-bit ro
0xFFF8AA18 CKSC_ICANOSCD_STPM 32-bit
0xFFF8AB00 CKSC_ICSIS_CTL 32-bit
0xFFF8AB08 CKSC_ICSIS_ACT 32-bit ro
0xFFF8AC00 CKSC_IIICS_CTL 32-bit
0xFFF8AC08 CKSC_IIICS_ACT 32-bit ro

## IPIR
{0xFFFEEC80+4i} IPIR_CH{i} 32-bit (i=0..3)
{0xFFFEEC80+4i} IPIR_CH{i}L 16-bit (i=0..3)
{0xFFFEEC80+4i} IPIR_CH{i}LL (i=0..3)
