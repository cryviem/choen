# ior7f701503 register map
Registers are 8-bit, access not given, no defined reset value unless marked. A register's access mark holds for its fields unless they carry their own. Addresses are absolute; registers are grouped by the start of their names; [hi:lo] are bit positions.

## IDERRINT
0xFFC60404 IDERRINT_PE1 32-bit
0xFFC60404 IDERRINT_PE1L 16-bit
0xFFC60404 IDERRINT_PE1LL
0xFFC60604 IDERRINT_PE2 32-bit
0xFFC60604 IDERRINT_PE2L 16-bit
0xFFC60604 IDERRINT_PE2LL

## IDSTCLR
0xFFC60408 IDSTCLR_PE1 32-bit wo
0xFFC60408 IDSTCLR_PE1L 16-bit wo
0xFFC60408 IDSTCLR_PE1LL wo
0xFFC60608 IDSTCLR_PE2 32-bit wo
0xFFC60608 IDSTCLR_PE2L 16-bit wo
0xFFC60608 IDSTCLR_PE2LL wo

## IDOVFSTR
0xFFC6040C IDOVFSTR_PE1 32-bit ro
0xFFC6040C IDOVFSTR_PE1L 16-bit ro
0xFFC6040C IDOVFSTR_PE1LL ro
0xFFC6060C IDOVFSTR_PE2 32-bit ro
0xFFC6060C IDOVFSTR_PE2L 16-bit ro
0xFFC6060C IDOVFSTR_PE2LL ro

## ID1STERSTR
0xFFC60410 ID1STERSTR_PE1 32-bit ro
0xFFC60410 ID1STERSTR_PE1L 16-bit ro
0xFFC60410 ID1STERSTR_PE1LL ro
0xFFC60411 ID1STERSTR_PE1LH ro
0xFFC60610 ID1STERSTR_PE2 32-bit ro
0xFFC60610 ID1STERSTR_PE2L 16-bit ro
0xFFC60610 ID1STERSTR_PE2LL ro
0xFFC60611 ID1STERSTR_PE2LH ro

## ID1STEADR0
0xFFC60450 ID1STEADR0_PE1 32-bit ro
0xFFC60450 ID1STEADR0_PE1L 16-bit ro
0xFFC60450 ID1STEADR0_PE1LL ro
0xFFC60451 ID1STEADR0_PE1LH ro
0xFFC60650 ID1STEADR0_PE2 32-bit ro
0xFFC60650 ID1STEADR0_PE2L 16-bit ro
0xFFC60650 ID1STEADR0_PE2LL ro
0xFFC60651 ID1STEADR0_PE2LH ro

## ID1STEADR1
0xFFC60454 ID1STEADR1_PE1 32-bit ro
0xFFC60454 ID1STEADR1_PE1L 16-bit ro
0xFFC60454 ID1STEADR1_PE1LL ro
0xFFC60455 ID1STEADR1_PE1LH ro
0xFFC60654 ID1STEADR1_PE2 32-bit ro
0xFFC60654 ID1STEADR1_PE2L 16-bit ro
0xFFC60654 ID1STEADR1_PE2LL ro
0xFFC60655 ID1STEADR1_PE2LH ro

## ITECCCTL
0xFFC61400 ITECCCTL_PE1 32-bit
0xFFC61400 ITECCCTL_PE1L 16-bit
0xFFC61600 ITECCCTL_PE2 32-bit
0xFFC61600 ITECCCTL_PE2L 16-bit

## ITERRINT
0xFFC61404 ITERRINT_PE1 32-bit
0xFFC61404 ITERRINT_PE1L 16-bit
0xFFC61404 ITERRINT_PE1LL
0xFFC61604 ITERRINT_PE2 32-bit
0xFFC61604 ITERRINT_PE2L 16-bit
0xFFC61604 ITERRINT_PE2LL

## ITSTCLR
0xFFC61408 ITSTCLR_PE1 32-bit wo
0xFFC61408 ITSTCLR_PE1L 16-bit wo
0xFFC61608 ITSTCLR_PE2 32-bit wo
0xFFC61608 ITSTCLR_PE2L 16-bit wo

## ITOVFSTR
0xFFC6140C ITOVFSTR_PE1 32-bit ro
0xFFC6140C ITOVFSTR_PE1L 16-bit ro
0xFFC6140C ITOVFSTR_PE1LL ro
0xFFC6160C ITOVFSTR_PE2 32-bit ro
0xFFC6160C ITOVFSTR_PE2L 16-bit ro
0xFFC6160C ITOVFSTR_PE2LL ro

## IT1STERSTR
0xFFC61410 IT1STERSTR_PE1 32-bit ro
0xFFC61410 IT1STERSTR_PE1L 16-bit ro
0xFFC61410 IT1STERSTR_PE1LL ro
0xFFC61610 IT1STERSTR_PE2 32-bit ro
0xFFC61610 IT1STERSTR_PE2L 16-bit ro
0xFFC61610 IT1STERSTR_PE2LL ro

## IT1STEADR0
0xFFC61450 IT1STEADR0_PE1 32-bit ro
0xFFC61450 IT1STEADR0_PE1L 16-bit ro
0xFFC61450 IT1STEADR0_PE1LL ro
0xFFC61451 IT1STEADR0_PE1LH ro
0xFFC61650 IT1STEADR0_PE2 32-bit ro
0xFFC61650 IT1STEADR0_PE2L 16-bit ro
0xFFC61650 IT1STEADR0_PE2LL ro
0xFFC61651 IT1STEADR0_PE2LH ro

## CFECCCTL
0xFFC62200 CFECCCTL_VCI 32-bit
0xFFC62200 CFECCCTL_VCIL 16-bit
0xFFC62400 CFECCCTL_PE1 32-bit
0xFFC62400 CFECCCTL_PE1L 16-bit
0xFFC62600 CFECCCTL_PE2 32-bit
0xFFC62600 CFECCCTL_PE2L 16-bit

## CFERRINT
0xFFC62204 CFERRINT_VCI 32-bit
0xFFC62204 CFERRINT_VCIL 16-bit
0xFFC62204 CFERRINT_VCILL
0xFFC62404 CFERRINT_PE1 32-bit
0xFFC62404 CFERRINT_PE1L 16-bit
0xFFC62404 CFERRINT_PE1LL
0xFFC62604 CFERRINT_PE2 32-bit
0xFFC62604 CFERRINT_PE2L 16-bit
0xFFC62604 CFERRINT_PE2LL

## CFSTCLR
0xFFC62208 CFSTCLR_VCI 32-bit wo
0xFFC62208 CFSTCLR_VCIL 16-bit wo
0xFFC62208 CFSTCLR_VCILL wo
0xFFC62408 CFSTCLR_PE1 32-bit wo
0xFFC62408 CFSTCLR_PE1L 16-bit wo
0xFFC62408 CFSTCLR_PE1LL wo
0xFFC62608 CFSTCLR_PE2 32-bit wo
0xFFC62608 CFSTCLR_PE2L 16-bit wo
0xFFC62608 CFSTCLR_PE2LL wo
